/*
 * vesc_com.c
 *
 *  Created on: 22 feb. 2023
 *      Author: jonathanloov
 */

#include "vesc_com.h"
#include "main.h" // for gpio pins
#include <string.h>
#include <stdbool.h>

_Bool dead_mans_switch_activated(); // prototype from main.c

// From https://github.com/vedderb/bldc_uart_comm_stm32f4_discovery
typedef enum {
	COMM_FW_VERSION = 0,
	COMM_JUMP_TO_BOOTLOADER,
	COMM_ERASE_NEW_APP,
	COMM_WRITE_NEW_APP_DATA,
	COMM_GET_VALUES,
	COMM_SET_DUTY,
	COMM_SET_CURRENT,
	COMM_SET_CURRENT_BRAKE,
	COMM_SET_RPM,
	COMM_SET_POS,
	COMM_SET_HANDBRAKE,
	COMM_SET_DETECT,
	COMM_SET_SERVO_POS,
	COMM_SET_MCCONF,
	COMM_GET_MCCONF,
	COMM_GET_MCCONF_DEFAULT,
	COMM_SET_APPCONF,
	COMM_GET_APPCONF,
	COMM_GET_APPCONF_DEFAULT,
	COMM_SAMPLE_PRINT,
	COMM_TERMINAL_CMD,
	COMM_PRINT,
	COMM_ROTOR_POSITION,
	COMM_EXPERIMENT_SAMPLE,
	COMM_DETECT_MOTOR_PARAM,
	COMM_DETECT_MOTOR_R_L,
	COMM_DETECT_MOTOR_FLUX_LINKAGE,
	COMM_DETECT_ENCODER,
	COMM_DETECT_HALL_FOC,
	COMM_REBOOT,
	COMM_ALIVE,
	COMM_GET_DECODED_PPM,
	COMM_GET_DECODED_ADC,
	COMM_GET_DECODED_CHUK,
	COMM_FORWARD_CAN,
	COMM_SET_CHUCK_DATA,
	COMM_CUSTOM_APP_DATA,
	COMM_NRF_START_PAIRING
} COMM_PACKET_ID;

const uint16_t crc16_tab[] = { 0x0000, 0x1021, 0x2042, 0x3063, 0x4084,
		0x50a5, 0x60c6, 0x70e7, 0x8108, 0x9129, 0xa14a, 0xb16b, 0xc18c, 0xd1ad,
		0xe1ce, 0xf1ef, 0x1231, 0x0210, 0x3273, 0x2252, 0x52b5, 0x4294, 0x72f7,
		0x62d6, 0x9339, 0x8318, 0xb37b, 0xa35a, 0xd3bd, 0xc39c, 0xf3ff, 0xe3de,
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		0x6e17, 0x7e36, 0x4e55, 0x5e74, 0x2e93, 0x3eb2, 0x0ed1, 0x1ef0 };


static uint8_t data[2 + 256 + 2 + 1];
static size_t current_offset = 0;
volatile static bool tx_waiting = false;

void vesc_uart_cb_txcplt(UART_HandleTypeDef huart) {
	// TODO: Clear the data? Not needed, but could aid debugging
	current_offset = 0;
	tx_waiting = false;
}

void vesc_queue_packet(uint8_t *content, size_t len) {
	if (len > 256) {
		// TODO: Not yet implemented
		return;
	}
	data[current_offset++] = 0x2; // short (<256 bytes) packet
	data[current_offset++] = (uint8_t) (len & 0xff);


	uint16_t crc16 = 0;
	for (size_t i = 0; i < len; i++) {
		data[current_offset++] = content[i];
		crc16 = (crc16 << 8) ^ crc16_tab[0xff & ((crc16 >> 8) ^ content[i])];
	}
	data[current_offset++] = (uint8_t) ((crc16 >> 8) & 0xff);
	data[current_offset++] = (uint8_t) (crc16 & 0xff);
	data[current_offset++] = 0x3;
}


void vesc_transmit(UART_HandleTypeDef *huart, UART_HandleTypeDef *dbghuart) {
	char *msg1 = "START_TX\r\n";
	HAL_UART_Transmit(dbghuart, (uint8_t*) msg1, strlen(msg1), 1000000);

	if (tx_waiting) {
		char *msg = "BLOCK_TX_WAITING\r\n";
		HAL_UART_Transmit(dbghuart, (uint8_t*) msg, strlen(msg), 1000000);

		HAL_GPIO_WritePin(LDERROR_GPIO_Port, LDERROR_Pin, GPIO_PIN_SET);

		while (tx_waiting) {
			__asm("nop");
		}
		HAL_GPIO_WritePin(LDERROR_GPIO_Port, LDERROR_Pin, GPIO_PIN_RESET);
	}

	char *msg2 = "TXING\r\n";
	HAL_UART_Transmit(dbghuart, (uint8_t*) msg2, strlen(msg2), 1000000);
	tx_waiting = true;
	HAL_UART_Transmit_IT(huart, data, current_offset);
}


void vesc_set_current(float current) {
	if (!dead_mans_switch_activated()) {
		current = 0.0;
	}

	uint8_t buf[5];
	buf[0] = COMM_SET_CURRENT;
	int32_t current_i = (int32_t) (current * 1000.0);
	// copy to big endian
	buf[1] = (current_i >> 24) & 0xff;
	buf[2] = (current_i >> 16) & 0xff;
	buf[3] = (current_i >> 8) & 0xff;
	buf[4] = (current_i >> 0) & 0xff;

	vesc_queue_packet(buf, 5);
}

void vesc_request_data() {
	uint8_t buf[1];
	buf[0] = COMM_GET_VALUES;

	vesc_queue_packet(buf, 1);
}
